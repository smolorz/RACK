## Kconfig
```kconfig
config RACK_VERSION
    string
    default "0.4.0"

mainmenu "RACK configuration"

menu "Build options"

choice
    prompt "Target OS"
    default RACK_OS_XENOMAI

config RACK_OS_XENOMAI
    bool "Xenomai"

config RACK_OS_LINUX
    bool "Linux"

endchoice

config RACK_XENOMAIDIR
    string "Xenomai installation tree"
    depends on RACK_OS_XENOMAI
    default "/usr/xenomai"
    help
    This option defines the directory where Xenomai is installed
    The default Xenomai installation directory is
    /usr/xenomai
    LiRE gcchost users use
    /usr/src/LiRE/xenomai

config RACK_BUILD_KMOD
    bool "Build kernel modules"
    depends on RACK_OS_XENOMAI
    default y

config RACK_LINUXDIR
    string "Linux source tree"
    depends on RACK_BUILD_KMOD
    default "/lib/modules/`uname -r`/build"
    help
    This option defines the directory of the Linux sources
    The default Linux source directory is
    /lib/modules/`uname -r`/build
    LiRE gcchost users use
    /usr/src/LiRE/linux/src

config RACK_INSTALLDIR
    string "Installation directory"
    default "/usr/local/rack"
    help
    This option defines the directory where the various RACK
    files will be installed on your system.
    The default installation directory is
    /usr/local/rack.
    LiRE gcchost users use
    /home/`whoami`/rack_install

config RACK_JAVA
    bool "Rack Java"
    default y

config RACK_JAVA_GUI
    bool "Rack Java Gui"
    default y
    depends on RACK_JAVA

config RACK_DOC_DOX
    bool "Generate Rack Doxygen API"
    default n

menu "External Dependencies"

config RACK_RTNET_SUPPORT
    depends on RACK_OS_XENOMAI
    bool "Enable RTnet support"

config RACK_RTNETDIR
    string "RTnet install directory"
    depends on RACK_RTNET_SUPPORT
    default "/usr/src/LiRE/rtnet"

config RACK_LIBRAW1394_SUPPORT
    bool "Enable libraw1394 support"

config RACK_LIBRAW1394DIR
    string "libraw1394 install directory"
    depends on RACK_LIBRAW1394_SUPPORT
    default "/usr/src/LiRE/libraw1394"

config RACK_LIBDC1394_SUPPORT
    bool "Enable libdc1394 support"
    select RACK_LIBRAW1394_SUPPORT

config RACK_LIBDC1394DIR
    string "libdc1394 install directory"
    depends on RACK_LIBDC1394_SUPPORT
    default "/usr/src/LiRE/libdc1394"

config RACK_LIBJPEG_SUPPORT
    bool "Enable libjpeg support"

config RACK_LIBJPEGDIR
    string "libjpeg install directory"
    depends on RACK_LIBJPEG_SUPPORT
    default "/usr/src/LiRE/libjpeg"

config RACK_LIBPNG_SUPPORT
    bool "Enable libpng support"

config RACK_LIBPNGDIR
    string "libpng install directory"
    depends on RACK_LIBPNG_SUPPORT
    default "/usr/src/LiRE/libpng"

config RACK_OPENCV_SUPPORT
    bool "Enable opencv support"
    select RACK_LIBJPEG_SUPPORT
    select RACK_LIBPNG_SUPPORT

config RACK_OPENCVDIR
    string "opencv install directory"
    depends on RACK_OPENCV_SUPPORT
    default "/usr/src/LiRE/opencv"

endmenu

endmenu

source "drivers/Kconfig"
source "navigation/Kconfig"
source "perception/Kconfig"
source "skel/Kconfig"
source "tools/Kconfig"
```

## automake/level1/drivers/Kconfig
```kconfig
menu "Drivers"

menu "Dummy"
config RACK_DUMMY_DRV_JAVA_GUI
    bool "Dummy Java GUI"
    depends on RACK_JAVA_GUI
    default y
    ---help---
    Help text.

source "drivers/dummy/Kconfig"
endmenu

endmenu
```

## automake/level1/navigation/Kconfig
```kconfig
menu "Navigation"

menu "DummyNav"
source "navigation/dummy/Kconfig"
endmenu

endmenu
```

## automake/level2/Kconfig
```kconfig
config RACK_LEVEL2_VERSION
    string
    default "0.0.1"

mainmenu "RACK-LEVEL2 configuration"

menu "Build options"

config RACK_INSTALLDIR
    string "Installation directory"
    default "/home/`whoami`/rack/bin"
    help
    This option defines the directory where the current RACK
    files will be installed on your target system.
    This directory may be changed if you double-click in the area
    named "Value". The default installation directory is the RACK
    directory /home/`whoami`/rack/bin.

config RACKDIR
    string "Rack build tree"
    default "/home/`whoami`/rack/bin"
    help
    This variable contains the directory where was built your
    Rack. As explained before, you can change the value
    of the Rack build tree which is fixed by default to
    /home/`whoami`/rack/bin i.e. the build directory of the running Rack.

config RACK_JAVA_GUI
    bool "Java Gui"
    help
    Help text.

endmenu

source "drivers/Kconfig"

source "navigation/Kconfig"

source "perception/Kconfig"
```

## automake/level2/perception/Kconfig
```kconfig
menu "Perception"

menu "Dummy"
source "perception/dummy/Kconfig"
endmenu

endmenu
```

## drivers/ladar/Kconfig
```kconfig
config RACK_LADAR_HOKUYO_URG
    bool "Ladar - HokuyoUrg"
    default y

config RACK_LADAR_IBEO
    bool "Ladar - Ibeo"
    default y
    help
    SICK IBEO LD-A

config RACK_LADAR_IBEO_LUX
    bool "Ladar - IbeoLux"
    default y

config RACK_LADAR_SICK_LMS200
    bool "Ladar - SickLms200"
    default y

config RACK_LADAR_SICK_S
    bool "Ladar - SickS"
    default y
    help
    SICK S300, SICK S3000
```

## rack/Kconfig
```kconfig
config RACK_VERSION
    string
    default "0.6.1"

mainmenu "RACK configuration"

menu "Build options"

config RACK_LIRE_INSTALLDIR
    string "LiRE Installdir (READ HELP!)"
    default "/home/`whoami`/LiRE"
    help
    If you specify the LiRE installdir all dependencies which normally are
    located inside the installdir do not need to be declared explicitly.
    This goes for all external dependencies like xenomai and all libraries.
    Nevertheless, you can still state an explicit path for every dependency
    if this is necessary.

choice
    prompt "Target OS"
    default RACK_OS_LINUX

config RACK_OS_XENOMAI
    bool "Xenomai"

config RACK_OS_LINUX
    bool "Linux"

endchoice

config RACK_EXT_XENOMAIDIR
    bool "Specify Xenomai installation tree explicitly"
    default n
    depends on RACK_OS_XENOMAI

config RACK_XENOMAIDIR
    string "Xenomai installation tree"
    depends on RACK_EXT_XENOMAIDIR
    default "/usr/xenomai"
    help
    This option defines the directory where Xenomai is installed
    The default Xenomai installation directory is
    /usr/xenomai

config RACK_BUILD_KMOD
    bool "Build kernel modules"
    depends on RACK_OS_XENOMAI
    default y

config RACK_LINUXDIR
    string "Linux source tree"
    depends on RACK_BUILD_KMOD
    default "/lib/modules/`uname -r`/build"
    help
    This option defines the directory of the Linux sources
    The default Linux source directory is
    /lib/modules/`uname -r`/build

config RACK_INSTALLDIR
    string "Installation directory"
    default "/home/`whoami`/rack_install"
    help
    This option defines the directory where the various RACK
    files will be installed on your system.
    
config RACK_JAVA
    bool "Rack Java"
    default y

config RACK_JAVA_GUI
    bool "Rack Java Gui"
    default y
    depends on RACK_JAVA

config RACK_DOC_DOX
    bool "Generate Rack Doxygen API"
    default n

menu "External Dependencies"

config RACK_RTNET_SUPPORT
    depends on RACK_OS_XENOMAI
    bool "Enable RTnet support"

config RACK_EXT_RTNETDIR
    bool "Specify RTnet install directory explicitly"
    default n
    depends on RACK_RTNET_SUPPORT

config RACK_RTNETDIR
    string "RTnet install directory"
    depends on RACK_EXT_RTNETDIR
    default "/usr/src/LiRE/rtnet"

config RACK_LIBRAW1394_SUPPORT
    bool "Enable libraw1394 support"

config RACK_EXT_LIBRAW1394DIR
    bool "Specify libraw1394 install directory explicitly"
    default n
    depends on RACK_LIBRAW1394_SUPPORT

config RACK_LIBRAW1394DIR
    string "libraw1394 install directory"
    depends on RACK_EXT_LIBRAW1394DIR
    default "/usr/src/LiRE/libraw1394"

config RACK_LIBDC1394_SUPPORT
    bool "Enable libdc1394 support"
    select RACK_LIBRAW1394_SUPPORT

config RACK_EXT_LIBDC1394DIR
    bool "Specify libdc1394 install directory explicitly"
    default n
    depends on RACK_LIBDC1394_SUPPORT

config RACK_LIBDC1394DIR
    string "libdc1394 install directory"
    depends on RACK_EXT_LIBDC1394DIR
    default "/usr/src/LiRE/libdc1394"

config RACK_LIBJPEG_SUPPORT
    bool "Enable libjpeg support"

config RACK_EXT_LIBJPEGDIR
    bool "Specify jpeg install directory explicitly"
    default n
    depends on RACK_LIBJPEG_SUPPORT

config RACK_LIBJPEGDIR
    string "libjpeg install directory"
    depends on RACK_EXT_LIBJPEGDIR
    default "/usr/src/LiRE/libjpeg"

config RACK_LIBPNG_SUPPORT
    bool "Enable libpng support"
    select RACK_ZLIB_SUPPORT

config RACK_EXT_LIBPNGDIR
    bool "Specify libpng install directory explicitly"
    default n
    depends on RACK_LIBPNG_SUPPORT

config RACK_LIBPNGDIR
    string "libpng install directory"
    depends on RACK_EXT_LIBPNGDIR
    default "/usr/src/LiRE/libpng"

config RACK_OPENCV_SUPPORT
    bool "Enable opencv support"
    select RACK_LIBJPEG_SUPPORT
    select RACK_LIBPNG_SUPPORT
    select RACK_LIBRAW1394_SUPPORT
    select RACK_LIBDC1394_SUPPORT

config RACK_EXT_OPENCVDIR
    bool "Specify opencv install directory explicitly"
    default n
    depends on RACK_OPENCV_SUPPORT

config RACK_OPENCVDIR
    string "opencv install directory"
    depends on RACK_EXT_OPENCVDIR
    default "/usr/src/LiRE/opencv"

config RACK_GSL_SUPPORT
    bool "Enable gsl support"

config RACK_EXT_GSLDIR
    bool "Specify gsl install directory explicitly"
    default n
    depends on RACK_GSL_SUPPORT

config RACK_GSLDIR
    string "gsl install directory"
    depends on RACK_EXT_GSLDIR
    default "/usr/src/LiRE/gsl"

config RACK_ZLIB_SUPPORT
    bool "Enable zlib support"

config RACK_EXT_ZLIBDIR
    bool "Specify zlib install directory explicitly"
    default n
    depends on RACK_ZLIB_SUPPORT

config RACK_ZLIBDIR
    string "zlib install directory"
    depends on RACK_EXT_ZLIBDIR
    default "/usr/src/LiRE/zlib"

config RACK_LIBUSB_SUPPORT
    bool "Enable libusb support"

config RACK_EXT_LIBUSBDIR
    bool "Specify libusb install directory explicitly"
    default n
    depends on RACK_LIBUSB_SUPPORT

config RACK_LIBUSBDIR
    string "libusb install directory"
    depends on RACK_EXT_LIBUSBDIR
    default "/usr/src/LiRE/libusb"

config RACK_BOOST_SUPPORT
    bool "Enable boost support"

config RACK_EXT_BOOSTDIR
    bool "Specify boost install directory explicitly"
    default n
    depends on RACK_BOOST_SUPPORT

config RACK_BOOSTDIR
    string "boost install directory"
    depends on RACK_EXT_BOOSTDIR
    default "/usr/src/LiRE/boost"

config RACK_PCL_SUPPORT
    bool "Enable pcl support"
    select RACK_BOOST_SUPPORT

config RACK_EXT_PCLDIR
    bool "Specify pcl install directory explicitly"
    default n
    depends on RACK_PCL_SUPPORT

config RACK_PCL_VERSION_SUFFIX
    string "Specify the used PCL's major version (only up to one decimal), e.g. 1.6"
    depends on RACK_PCL_SUPPORT
    default 1.6

config RACK_PCLDIR
    string "pcl install directory"
    depends on RACK_EXT_PCLDIR
    default "/usr/src/LiRE/pcl"

config RACK_OPENNI_SUPPORT
    bool "Enable openni support"
    select RACK_LIBUSB_SUPPORT

config RACK_EXT_OPENNIDIR
    bool "Specify openni install directory explicitly"
    default n
    depends on RACK_OPENNI_SUPPORT

config RACK_OPENNIDIR
    string "openni install directory"
    depends on RACK_EXT_OPENNIDIR
    default "/usr/src/LiRE/openni/usr"

endmenu

config RACK_CROSS_COMPILE
    bool "Use own toolchain"
    default y

config RACK_TARGET_TUPLE
    string "target tuple or alias"
    default i586-nptl-linux-gnu
    depends on RACK_CROSS_COMPILE

config RACK_TOOLCHAIN_PARENT_DIR
    string "Parent directory of the toolchain"
    default /opt
    depends on RACK_CROSS_COMPILE

endmenu

source "control/Kconfig"
source "drivers/Kconfig"
source "navigation/Kconfig"
source "perception/Kconfig"
source "skel/Kconfig"
source "tools/Kconfig"

menu "Advanced settings"

choice
    prompt "Message size and data format in proxies"
    default RACK_PROXIES_MSG_SIZE_SCANDRIVE

config RACK_PROXIES_MSG_SIZE_SCANDRIVE
    bool "Use ScanDrive"

config RACK_PROXIES_MSG_SIZE_VELODYNE
    bool "Use Velodyne"

config RACK_PROXIES_MSG_SIZE_KINECT
    bool "Use Kinect"

endchoice

endmenu
```

## rack/drivers/Kconfig
```kconfig
menu "Drivers"

menu "Camera"
source "drivers/camera/Kconfig"
endmenu

menu "Chassis"
source "drivers/chassis/Kconfig"
endmenu

menu "Clock"
source "drivers/clock/Kconfig"
endmenu

menu "Compass"
source "drivers/compass/Kconfig"
endmenu

menu "Gps"
source "drivers/gps/Kconfig"
endmenu

menu "Gyro"
source "drivers/gyro/Kconfig"
endmenu

menu "Ladar"
source "drivers/ladar/Kconfig"
endmenu

endmenu
```

## rack/drivers/camera/Kconfig
```kconfig
config RACK_CAMERA_DCAM
    bool "Camera - Dcam"
    select RACK_LIBDC1394_SUPPORT
    default n

config RACK_CAMERA_FILE
    bool "Camera - File"
    default y

config RACK_CAMERA_JPEG
    bool "Camera - Jpeg"
    select RACK_LIBJPEG_SUPPORT
    default n

config RACK_CAMERA_V4L
    bool "Camera - V4l"
    default n
```

## rack/drivers/chassis/Kconfig
```kconfig
config RACK_CHASSIS_SIM
    bool "Chassis - Sim"
    default y

config RACK_CHASSIS_PIONEER
    bool "Chassis - Pioneer"
    default y

config RACK_CHASSIS_ER1
    bool "Chassis - Er1"
    default y

config RACK_CHASSIS_ROOMBA
    bool "Chassis - Roomba"
    default y
```

## rack/drivers/clock/Kconfig
```kconfig
config RACK_CLOCK_DCF77_EMC_PRO
    bool "Clock - Dcf77EmcPro"
    default y

config RACK_CLOCK_DCF77_MBG_C51
    bool "Clock - Dcf77MbgC51"
    default y
```

## rack/drivers/gps/Kconfig
```kconfig
config RACK_GPS_NMEA
    bool "GPS nmea"
    default y
    ---help---
    Help text.
```

## rack/drivers/joystick/Kconfig
```kconfig
config RACK_JOYSTICK_SOFTWARE
    bool "Joystick Software java module"
    depends on RACK_JAVA_GUI
    default y
    ---help---
    Help text.
```

## rack/drivers/ladar/Kconfig
```kconfig
config RACK_LADAR_IBEO
    bool "Ladar Ibeo"
    ---help---

config RACK_LADAR_HOKUYO_URG
    bool "Ladar Hokuyo urg"
    ---help---

config RACK_LADAR_SICK_LMS200
    bool "Ladar Sick LMS200"
    default y
    ---help---

config RACK_LADAR_SICK_S
    bool "Ladar Sick S"
    default y
    ---help---
```
