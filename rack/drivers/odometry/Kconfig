## rack/drivers/odometry/Kconfig
```kconfig
config RACK_ODOMETRY_CHASSIS
    bool "Odometry Chassis"
    default y
    ---help---
    Help text.
```

## rack/main/Kconfig
```kconfig
menu "Main"

config RACK_RTNET_SUPPORT
    bool "Enable RTnet support"
    help
    Enable RTnet support for Rack.

config RACK_RTNETDIR
    string "RTnet install directory"
    depends on RACK_RTNET_SUPPORT
    default ""
    help

config RACK_LIBRAW1394_SUPPORT
    bool "Enable libraw1394 support"
    help
    Enable ieee1394 firewire support for Rack.

config RACK_LIBRAW1394DIR
    string "libraw1394 install directory"
    depends on RACK_LIBRAW1394_SUPPORT
    default ""
    help

config RACK_LIBDC1394_SUPPORT
    bool "Enable libdc1394 support"
    select RACK_LIBRAW1394_SUPPORT
    help
    Enable ieee1394 digital camera support for Rack.

config RACK_LIBDC1394DIR
    string "libdc1394 install directory"
    depends on RACK_LIBDC1394_SUPPORT
    default ""
    help

config RACK_LIBJPEG_SUPPORT
    bool "Enable libjpeg support"
    help
    Enable libjpeg support for Rack.

config RACK_LIBJPEGDIR
    string "libjpeg install directory"
    depends on RACK_LIBJPEG_SUPPORT
    default ""
    help

config RACK_LIBPNG_SUPPORT
    bool "Enable libpng support"
    help
    Enable libpng support for Rack.

config RACK_LIBPNGDIR
    string "libpng install directory"
    default ""
    depends on RACK_LIBPNG_SUPPORT
    help

config RACK_OPENCV_SUPPORT
    bool "Enable opencv support"
    select RACK_LIBDC1394_SUPPORT
    select RACK_LIBRAW1394_SUPPORT
    select RACK_LIBJPEG_SUPPORT
    select RACK_LIBPNG_SUPPORT
    help
    Enable opencv support for Rack.

config RACK_OPENCVDIR
    string "opencv install directory"
    depends on RACK_OPENCV_SUPPORT
    default ""
    help

endmenu
```

## rack/navigation/Kconfig
```kconfig
menu "Navigation"

menu "Odometry"
source "navigation/odometry/Kconfig"
endmenu

menu "Pilot"
source "navigation/pilot/Kconfig"
endmenu

menu "Position"
source "navigation/position/Kconfig"
endmenu

endmenu
```

## rack/navigation/pilot/Kconfig
```kconfig
config RACK_PILOT_JOYSTICK
    bool "Pilot - Joystick"
    default y

config RACK_PILOT_WALL_FOLLOWING
    bool "Pilot - WallFollowing"
    default y

config RACK_PILOT_LAB
    bool "Pilot - Laboratory"
    default y
```

## rack/navigation/position/Kconfig
```kconfig
config RACK_POSITION
    bool "Position"
    default y
    ---help---
    Help text.
```

## rack/perception/Kconfig
```kconfig
menu "Perception"

menu "Scan2d"
source "perception/scan2d/Kconfig"
endmenu

menu "ObjRecog"
source "perception/obj_recog/Kconfig"
endmenu

endmenu
```

## rack/perception/obj_recog/Kconfig
```kconfig
config RACK_OBJ_RECOG_IBEO_LUX
    bool "ObjRecog - IbeoLux"
    default y

config RACK_OBJ_RECOG_RELAY_LADAR
    bool "ObjRecog - RelayLadar"
    default y
```

## rack/perception/scan2d/Kconfig
```kconfig
config RACK_SCAN2D
    bool "Scan2d"
    default y

config RACK_SCAN2D_MERGE
    bool "Scan2d - Merge"
    default y

config RACK_SCAN2D_SIM
    bool "Scan2d - Sim"
    default y

config RACK_SCAN2D_LAB
    bool "Scan2d - Lab"
    default y
```

## rack/skel/dummy/Kconfig
```kconfig
config RACK_DUMMY_ABC
    bool "Dummy Abc"
    default n
    ---help---
    Help text.
```

## rack/tools/datalog/Kconfig
```kconfig
config DATALOG_REC
    bool "Datalog - Rec"
    default y
    ---help---
    Record data from RACK modules
```
